#include "stm32f7xx.h"
#include <stdio.h>

//PC2 PD3 PB8 Registros

// INTERRUPCION PD11 FLANCO ASCENDENTE 

int main(){
	RCC->AHB1ENR |= RCC_AHB1ENR_GPIOBEN; // PB8
	GPIOB->MODER |= 0x10000; 
	GPIOB->OTYPER &= 0x0;
	GPIOB->OSPEEDR &= 0x0;
	RCC->AHB1ENR |= RCC_AHB1ENR_GPIOCEN; // PC2
	GPIOC->MODER |= 0x10;
	GPIOC->OTYPER &= 0x0;
	GPIOC->OSPEEDR &= 0x0;
	RCC->AHB1ENR |= RCC_AHB1ENR_GPIODEN; // PD3
	GPIOD->MODER |= 0x40; 
	GPIOD->OTYPER &= 0x0;
	GPIOD->OSPEEDR &= 0x0;
	
	RCC->APB2ENR |= (1<<14); //SE ACTIVA LA INTERRUPCION
	RCC->AHB1ENR |= RCC_AHB1ENR_GPIODEN; // PD11
	GPIOD->MODER |= 0x400000;
	GPIOD->OTYPER &= 0x0;
	GPIOD->OSPEEDR &= 0x0;
	GPIOD->PUPDR |= 0x820000; // PD11 //SE PONE EN PULL DOWN, PORQUE LA INTERRUPCION SE ACTIVARA CON UN FLANCO DE SUBIDA
	
	SYSCFG->EXTICR[2] |= 0x3000; 
	EXTI->IMR |= (1<<11);
	EXTI->RTSR |= (1<<11); //Rising 
	
	NVIC_EnableIRQ(EXTI15_10_IRQn); //PERMITE HABILITAR LA INTERRUPCION

	while(1){
		if((GPIOC->IDR & ((0x40 0000))) == 0x400000)
			{
				GPIOB->ODR |= 0x10000;
				GPIOC->ODR |= 0x10;
				GPIOD->ODR |= 0x40;
			}
			else if {}
	}
}

extern "C"{
	void EXTI15_10_IRQHandler(void){
		EXTI->PR |= (1<<11); //BAJA LA BANDERA, PONE UN 0 PARA AVISAR QUE TERMINO LA INTERRUPCION
	}
}